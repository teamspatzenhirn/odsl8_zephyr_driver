## drivers/sensor/leuze/odsl8/Kconfig
```kconfig
# Leuze ODSL8 distance sensor configuration options

# SPDX-License-Identifier: Apache-2.0

menuconfig ODSL8
	bool "Leuze ODSL8 distance sensor"
	default y
    depends on DT_HAS_LEUZE_ODSL8_ENABLED
	select ADC
	select SENSOR
	help
	  Enable Leuze ODSL8 distance sensor
```
